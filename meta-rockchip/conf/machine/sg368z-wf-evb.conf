## meta-rockchip/conf/machine/sg368z-wf-evb.conf
```bitbake
# Copyright (c) 2020-2025,Bruce
# Released under the MIT license (see COPYING.MIT for the terms)

#@TYPE: Machine
#@NAME: SG368Z-WF-EVB
#@DESCRIPTION: New generation hardware platform based on RK3568EVB

require conf/machine/include/rk356x.inc

KERNEL_DEVICETREE = "rockchip/rk3568-evb1-ddr4-v10-linux.dtb"

UBOOT_MACHINE = "rk3568_defconfig"

RK_WIFIBT_RRECOMMENDS = " \
	rkwifibt-firmware-ap6398s-wifi \
	rkwifibt-firmware-ap6398s-bt \
	brcm-tools \
"

MACHINE_EXTRA_RRECOMMENDS:append = " \
	drm-cursor \
"
```
